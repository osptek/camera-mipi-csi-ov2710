## examples/esp32p4c6-395mipi-480x480-camera_ov2710-demo/sdkconfig.defaults
```kconfig
CONFIG_APP_CAMERA_INTERFACE_MIPI_CSI=y
# CONFIG_APP_CAMERA_INTERFACE_DVP is not set

CONFIG_APP_CAMERA_SENSOR_SELECTION_OV2710=y

CONFIG_CAMERA_OV2710=y
CONFIG_CAMERA_OV2710_AUTO_DETECT=y
CONFIG_CAMERA_OV2710_AUTO_DETECT_MIPI_INTERFACE_SENSOR=y
# CONFIG_CAMERA_OV2710_MIPI_RAW10_1920x1080_30FPS is not set
CONFIG_CAMERA_OV2710_MIPI_RAW10_1280x720_60FPS=y
# CONFIG_CAMERA_SC202CS is not set
# CONFIG_CAMERA_SC202CS_AUTO_DETECT is not set
# CONFIG_CAMERA_SC202CS_AUTO_DETECT_MIPI_INTERFACE_SENSOR is not set

CONFIG_APP_CAMERA_FRAME_WIDTH=480
CONFIG_APP_CAMERA_FRAME_HEIGHT=480
CONFIG_APP_CAMERA_BUFFER_COUNT=2
CONFIG_APP_CAMERA_PIXEL_FORMAT_RGB565=y
# CONFIG_APP_CAMERA_PIXEL_FORMAT_RGB888 is not set

# Preview post-processing
# CONFIG_APP_CAMERA_RGB565_BYTE_SWAP is not set
# CONFIG_APP_CAMERA_RGB565_RB_SWAP is not set
# CONFIG_APP_CAMERA_ENABLE_TEST_PATTERN is not set
# CONFIG_APP_CAMERA_ENABLE_VFLIP is not set
# CONFIG_APP_CAMERA_ENABLE_HFLIP is not set
CONFIG_APP_CAMERA_TASK_STACK_SIZE=8192
CONFIG_APP_CAMERA_TASK_PRIORITY=5

CONFIG_APP_CAMERA_SCCB_I2C_PORT=0
CONFIG_APP_CAMERA_SCCB_I2C_FREQ=100000

CONFIG_APP_CAMERA_MIPI_SCCB_SCL_PIN=8
CONFIG_APP_CAMERA_MIPI_SCCB_SDA_PIN=7
CONFIG_APP_CAMERA_OV2710_MIPI_RESET_PIN=-1
CONFIG_APP_CAMERA_OV2710_MIPI_PWDN_PIN=-1
# CONFIG_APP_CAMERA_MIPI_DONT_INIT_LDO is not set
```
